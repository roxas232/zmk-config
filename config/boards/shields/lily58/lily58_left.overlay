/ {
    kscan0: kscan {
        compatible = "zmk,kscan-gpio-matrix";

        col-gpios = <
            &gpio0 6  GPIO_ACTIVE_HIGH   // ← REPLACES B6 (your broken pin)
            &gpio0 7  GPIO_ACTIVE_HIGH
            &gpio0 8  GPIO_ACTIVE_HIGH
            &gpio0 9  GPIO_ACTIVE_HIGH
            &gpio0 10 GPIO_ACTIVE_HIGH
            &gpio0 11 GPIO_ACTIVE_HIGH
        >;
    };
};
